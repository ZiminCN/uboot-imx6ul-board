## board/freescale/mx6ul_zimin_board/Kconfig
```kconfig
if TARGET_ZIMIN_BOARD

config SYS_BOARD
	default "mx6ul_zimin_board"

config SYS_VENDOR
	default "freescale"

config SYS_CONFIG_NAME
	default "mx6ul_zimin_board"

config SYS_TEXT_BASE
	default 0x87800000

endif
```

## board/freescale/zimin_board/Kconfig
```kconfig
if TARGET_ZIMIN_BOARD

config SYS_BOARD
	default "zimin_board"

config SYS_VENDOR
	default "freescale"

config SYS_CONFIG_NAME
	default "zimin_board"

config SYS_TEXT_BASE
	default 0x87800000

endif
```
