/*
 * Copyright (C) 2015 Freescale Semiconductor, Inc.
 *
 * This program is free software; you can redistribute it and/or modify
 * it under the terms of the GNU General Public License version 2 as
 * published by the Free Software Foundation.
 */

/dts-v1/;

#include <dt-bindings/input/input.h>
#include "imx6ul.dtsi"
#include "imx6ul-zimin-board-evk.dtsi"

/ {
	model = "Freescale i.MX6 UltraLite Zimin Board";
	compatible = "fsl,imx6ul-14x14-evk", "fsl,imx6ul";
};
